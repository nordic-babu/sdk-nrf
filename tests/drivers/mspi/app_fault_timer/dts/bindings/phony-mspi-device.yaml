## tests/drivers/mspi/app_fault_timer/dts/bindings/phony-mspi-device.yaml
```yaml
#
# Copyright (c) 2026 Nordic Semiconductor ASA
#
# SPDX-License-Identifier: LicenseRef-Nordic-5-Clause
#

description: Phony MSPI device

compatible: "phony-mspi-device"

include:
  - name: mspi-device.yaml
```

## tests/drivers/mspi/app_fault_timer/testcase.yaml
```yaml
common:
  tags:
    - ci_tests_drivers_hpf
    - drivers
    - mspi
  harness: ztest
  harness_config:
    fixture: external_flash

tests:
  drivers.mspi.hpf_app_fault_timer:
    platform_allow:
      - nrf54l15dk/nrf54l15/cpuapp
      - nrf54lm20dk/nrf54lm20a/cpuapp
      - nrf54lm20dk/nrf54lm20b/cpuapp
    integration_platforms:
      - nrf54l15dk/nrf54l15/cpuapp
  drivers.mspi.hpf_app_fault_timer.phony_mspi_dev:
    platform_allow:
      - nrf54lv10dk/nrf54lv10a/cpuapp
    integration_platforms:
      - nrf54lv10dk/nrf54lv10a/cpuapp
    extra_args:
      - EXTRA_DTC_OVERLAY_FILE="boards/phony_device.overlay"
```
